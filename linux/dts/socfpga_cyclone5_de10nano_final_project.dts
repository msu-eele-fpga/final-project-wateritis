#include "socfpga_cyclone5_de10nano.dtsi"

/{
    pwm: pwm@ff25E240 {
        compatible = "Vincent,pwm";
        reg = <0xff25E240 16>;
    };

    de10nano_adc: adc@ff200000 {
    compatible = "adsd,de10nano_adc";
    reg = <0xff200000 32>;
};
};